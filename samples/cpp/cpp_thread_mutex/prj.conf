## CMakeLists.txt
```
# SPDX-License-Identifier: Apache-2.0

cmake_minimum_required(VERSION 3.20.0)
find_package(Zephyr REQUIRED HINTS $ENV{ZEPHYR_BASE})
project(cpp_thread_mutex)

zephyr_include_directories(inc)

target_sources(app PRIVATE src/main.cpp)
```

## prj.conf
```kconfig
CONFIG_CPP=y
CONFIG_CPP_MAIN=y
CONFIG_COMMON_LIBC_MALLOC_ARENA_SIZE=128
```

## src/main.cpp
```c
/**
 * @file C++ thread and mutex demo.  Uses basic C++ functionality.
 */

#include <stdio.h>
#include <zephyr/kernel.h>
#include <zephyr/arch/cpu.h>
#include <zephyr/sys/printk.h>
#include <mutex.h>
#include <thread.h>

/* specify delay between greetings (in ms); compute equivalent in ticks */
#define SLEEPTIME  500


std::mutex mut_main;
std::mutex mut_coop;

void coop_thread_entry(void)
{
	struct k_timer timer;

	k_timer_init(&timer, NULL, NULL);

	while (1) {
		/* wait for main thread to let us have a turn */
		

		/* say "hello" */
		printk("%s: Hello World!\n", __FUNCTION__);

		//sem_coop.wait();
		mut_coop.lock();

		/* wait a while, then let main thread have a turn */
		k_timer_start(&timer, K_MSEC(SLEEPTIME), K_NO_WAIT);
		k_timer_status_sync(&timer);
		//sem_main.give();
		printk("%s: Hello World2!\n", __FUNCTION__);
		mut_main.unlock();
	}
}

int main(void)
{
	struct k_timer timer;

	
    std::thread t1(coop_thread_entry, NULL);
			
	k_timer_init(&timer, NULL, NULL);

	while (1) {
		/* say "hello" */
		printk("%s: Hello World!\n", __FUNCTION__);

		/* wait a while, then let coop thread have a turn */
		k_timer_start(&timer, K_MSEC(SLEEPTIME), K_NO_WAIT);
		k_timer_status_sync(&timer);
		//sem_coop.give();
		mut_coop.unlock();

		/* Wait for coop thread to let us have a turn */
		//sem_main.wait();
		printk("%s: Hello World2!\n", __FUNCTION__);
		mut_main.lock();
	}

	return 0;
}
```

## inc/mutex.h
```c
#ifndef OWN_MUTEX_H_INCLUDED
#define OWN_MUTEX_H_INCLUDED

//#include "ipc-log.h"


#include <stdio.h>
#include <zephyr/kernel.h>
#include <zephyr/arch/cpu.h>
#include <zephyr/sys/printk.h>

namespace std
{
class mutex
  {
  public:
    struct k_sem _sema_internal;

    mutex()
    {
      k_sem_init(&_sema_internal, 0, K_SEM_MAX_LIMIT);
    }

    ~mutex()
    {
    }

    void lock()
    {
      printk("%s: Before!\n", __FUNCTION__);
      k_sem_take(&_sema_internal, K_FOREVER);
      printk("%s: After!\n", __FUNCTION__);
    }

    void unlock()
    {
      printk("%s: Before!\n", __FUNCTION__);
      k_sem_give(&_sema_internal);
      printk("%s: After!\n", __FUNCTION__);
    }

  private:

  };
}

#endif
```

## inc/thread.h
```c
#ifndef OWN_THREAD_H_INCLUDED
#define OWN_THREAD_H_INCLUDED


#include <zephyr/kernel.h>



namespace std
{

#define STACKSIZE 2000

K_THREAD_STACK_DEFINE(coop_stack, STACKSIZE);


  class thread {
  public:
    struct k_thread _thread;

    thread(void (*func)(), void* arg) {

	    k_thread_create(&_thread, coop_stack, STACKSIZE,
	    (k_thread_entry_t) func,
	    NULL, NULL, NULL, K_PRIO_COOP(7), 0, K_NO_WAIT);
  }

  ~thread() {
    k_thread_join(&_thread, K_NO_WAIT);
  }

  private:
    
 };
}

#endif
```
